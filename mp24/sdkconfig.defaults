## mp24/sdkconfig.defaults
```kconfig
# MAKERphone v2.4 production firmware — sdkconfig.defaults
#
# Target: ESP32-S3FH4R2 (4 MB flash, 2 MB octal PSRAM)
# Requires ESP-IDF v5.5+

CONFIG_IDF_TARGET="esp32s3"

# -------------------------------------------------------------------
# Flash
# -------------------------------------------------------------------
CONFIG_ESPTOOLPY_FLASHSIZE_4MB=y
CONFIG_ESPTOOLPY_FLASHSIZE="4MB"
CONFIG_ESPTOOLPY_FLASHMODE_QIO=y
CONFIG_ESPTOOLPY_FLASHFREQ_80M=y

# -------------------------------------------------------------------
# PSRAM (Decision: enabled for production)
# ESP32-S3FH4R2 has 2 MB *quad* SPI PSRAM (the "R2" suffix marks
# quad — only "FN8R8", "FH4R8" etc. variants have octal PSRAM).
# Using OCT mode against this chip makes the bootloader's JEDEC-ID
# handshake fail and CONFIG_SPIRAM_BOOT_INIT halts boot before
# app_main runs.
# -------------------------------------------------------------------
CONFIG_SPIRAM=y
CONFIG_SPIRAM_MODE_QUAD=y
CONFIG_SPIRAM_SPEED_80M=y
CONFIG_SPIRAM_USE_MALLOC=y
CONFIG_SPIRAM_TRY_ALLOCATE_WIFI_LWIP=y

# -------------------------------------------------------------------
# Console — Decision F1: USB-based console on the native USB-C port.
# Frees GPIO 43/44 for UMAX I²C.
#
# Originally specced as USB-OTG CDC (CONFIG_ESP_CONSOLE_USB_CDC).
# That works but it puts a soft-init peripheral (TinyUSB) on the path
# and shares GPIO 19/20 with USB-Serial/JTAG — so any firmware halt
# *before* USB-OTG re-enumeration leaves the chip unreachable from
# esptool, and recovery requires physically pressing SW24 (the
# in-case BOOT button) at power-on. Hit that failure mode while
# bringing up S-MP05; switched to the hardware-level USB-Serial/JTAG
# controller instead. Trade-offs:
#
#   USB-Serial/JTAG  | USB-OTG CDC
#   ---------------- | -------------------------------------------
#   Always-on        | Initialised by TinyUSB during app start
#   Survives panics  | Brick risk if panic before re-enumeration
#   ~1 Mbit/s burst  | Up to 12 Mbit/s
#   Built into ROM   | Adds ~25 KB TinyUSB
#
# Console traffic is light (ESP_LOGI lines); we gain nothing from
# USB-OTG's higher bandwidth and lose unbrick-ability. Decision F1
# now means "USB-Serial/JTAG console", same end goal (no UART0).
# -------------------------------------------------------------------
CONFIG_ESP_CONSOLE_USB_SERIAL_JTAG=y

# -------------------------------------------------------------------
# Logging
# -------------------------------------------------------------------
CONFIG_LOG_DEFAULT_LEVEL_INFO=y
CONFIG_LOG_MAXIMUM_LEVEL_DEBUG=y
CONFIG_LOG_COLORS=y

# -------------------------------------------------------------------
# Watchdog — re-enabled for production
# -------------------------------------------------------------------
CONFIG_ESP_TASK_WDT_EN=y
CONFIG_ESP_TASK_WDT_INIT=y
CONFIG_ESP_TASK_WDT_TIMEOUT_S=10
CONFIG_ESP_TASK_WDT_CHECK_IDLE_TASK_CPU0=y
CONFIG_ESP_TASK_WDT_CHECK_IDLE_TASK_CPU1=y

# -------------------------------------------------------------------
# Partition table — Decision D
# 4-entry layout: nvs + phy + 2 MB app + 2 MB SPIFFS
# -------------------------------------------------------------------
CONFIG_PARTITION_TABLE_CUSTOM=y
CONFIG_PARTITION_TABLE_CUSTOM_FILENAME="partitions.csv"

# -------------------------------------------------------------------
# FreeRTOS — main app on PRO_CPU, peripheral / RF on APP_CPU
# -------------------------------------------------------------------
CONFIG_FREERTOS_HZ=1000

# -------------------------------------------------------------------
# Bootloader log level — INFO during bring-up so PSRAM init, partition
# table mount, etc. are all visible via the USB-Serial/JTAG console.
# Drop to WARN once the firmware is reliably booting.
# -------------------------------------------------------------------
CONFIG_BOOTLOADER_LOG_LEVEL_INFO=y

# -------------------------------------------------------------------
# C++ exceptions — required by upstream src/ phone-firmware code
#
# S-MP17a discovery: src/Interface/LVScreen.cpp's destructor calls
# `throw std::exception()` if a screen is destroyed while still
# running. ESP-IDF's default is exceptions OFF (smaller binary,
# faster), which makes the compiler reject the throw at compile
# time with 'exception handling disabled'.
#
# Enabling adds a few KB of unwind tables to the binary but unblocks
# the entire src/ corpus. Worth it. If we ever want exceptions back
# off, we'd need to patch ~30 src/ files that use throw — which is
# the kind of upstream divergence we're explicitly trying to avoid.
# -------------------------------------------------------------------
CONFIG_COMPILER_CXX_EXCEPTIONS=y

# -------------------------------------------------------------------
# LVGL features needed by upstream src/ code
#
# S-MP17b discovery: Pics.cpp creates an lv_gif widget for any
# .gif asset (used by sticker / emoji-pack assets that the
# upstream firmware ships). lv_gif_create / lv_gif_set_src live
# in the LV_USE_GIF feature module, off by default in LVGL 8's
# Kconfig defaults.
#
# Cost: ~1 KB code + minimal RAM (only loaded when an animated
# asset is actually used). Worth it — upstream Pics.cpp is a
# header included from many screens and a missing widget here
# poisons every transitive .cpp.
# -------------------------------------------------------------------
CONFIG_LV_USE_GIF=y
```
